## overlay/package/local/onnxruntime-rknn/Config.in
```kconfig
config BR2_PACKAGE_ONNXRUNTIME_RKNN
	bool "onnxruntime (RKNN backend)"
	depends on BR2_PACKAGE_RKNPU2
	help
	  ONNX Runtime 的 RKNN 后端实现，基于 Rockchip 官方 airockchip/onnxruntime。
	  提供 C/C++ API，可加载 .onnx 模型并通过 RKNN 在 NPU 上推理。
	  默认从 https://github.com/airockchip/onnxruntime 检出 master 分支。
	  依赖：rknpu2, libcurl, pthread. 安装路径：/usr/lib/onnxruntime-rknn/

config BR2_PACKAGE_ONNXRUNTIME_RKNN_VERSION
	string "onnxruntime-rknn version"
	default "master"
	depends on BR2_PACKAGE_ONNXRUNTIME_RKNN
	help
	  git ref (branch/tag/commit) for airockchip/onnxruntime.
```

## overlay/package/local/rkbuild-docker-helper/Config.in
```kconfig
config BR2_PACKAGE_RKBUILD_DOCKER_HELPER
	bool "rkbuild-docker-helper"
	depends on BR2_PACKAGE_DOCKER_ENGINE
	help
	  Docker 相关辅助脚本：
	    - /usr/local/bin/rkbuild-docker-info
	    - /usr/local/bin/rkbuild-docker-preload
	    - /etc/init.d/S96docker-preload
	    - /usr/share/rkbuild/docker-images/ 预置镜像目录占位
	  默认开启。
```

## overlay/package/local/rkbuild-docker-images/Config.in
```kconfig
config BR2_PACKAGE_RKBUILD_DOCKER_IMAGES
	bool "rkbuild-docker-images (preload common images)"
	depends on BR2_PACKAGE_RKBUILD_DOCKER_HELPER
	help
	  自动 docker save 一组常用镜像到 /usr/share/rkbuild/docker-images/，
	  firstboot 由 rkbuild-docker-preload 自动 docker load。
	  镜像列表在 BR2_PACKAGE_RKBUILD_DOCKER_IMAGES_LIST 中定义（空格分隔）。

if BR2_PACKAGE_RKBUILD_DOCKER_IMAGES

config BR2_PACKAGE_RKBUILD_DOCKER_IMAGES_LIST
	string "image list (space-separated)"
	default "alpine:latest busybox:latest hello-world"
	help
	  形如 "alpine:latest library/python:3.11-slim nginx:alpine"。

endif
```

## overlay/package/local/rkbuild-helper/Config.in
```kconfig
config BR2_PACKAGE_RKBUILD_HELPER
	bool "rkbuild-helper"
	depends on BR2_PACKAGE_BUSYBOX || BR2_PACKAGE_SYSTEMD
	help
	  rkbuild 自有辅助脚本集：
	    - /usr/local/bin/rkbuild-info    显示版本与硬件信息
	    - /usr/local/bin/rkbuild-doctor  环境健康检查
	    - /etc/profile.d/rkbuild.sh      shell 启动钩子
	    - /etc/rkbuild-release           版本号文件
	    - /etc/motd                      登录欢迎信息
	  默认开启。
```

## overlay/package/local/tflite-delegate-rknpu2/Config.in
```kconfig
config BR2_PACKAGE_TFLITE_DELEGATE_RKNPU2
	bool "tflite (RKNN delegate)"
	depends on BR2_PACKAGE_RKNPU2
	help
	  TensorFlow Lite 的 RKNN delegate，让 .tflite 模型通过 RKNN 在 NPU 上推理。
	  基于 https://github.com/airockchip/TensorflowLite-bin 预编译包或自编译。
	  注：原计划用 choice/endchoice 区分 prebuilt/source，但 merge_config.sh 对 sourced 文件
	  报 'different file' 错误；先用单选项简化，默认走预编译。

config BR2_PACKAGE_TFLITE_DELEGATE_RKNPU2_SOURCE
	bool "build tflite-rknpu2 from source"
	depends on BR2_PACKAGE_TFLITE_DELEGATE_RKNPU2
	help
	  默认走 airockchip/TensorflowLite-bin 预编译包；勾选此项改为从源码编译。
	  源码编译耗时较长（数十分钟）。
```
